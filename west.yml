## west.yml
```yaml
manifest:
  defaults:
    remote: origin

  remotes:
    - name: origin
      url-base: https://github.com/nulix

  projects:
    - name: bsp
      revision: 9dfa667a196d71a89fa53893f8146dc22ea7d8a4
      path: bsp
    - name: rootfs
      revision: 64c0a2a447e741383386530f46e580ae375d1b9c
      path: rootfs
    - name: tools
      revision: bfe960d9a904c562843d0d2812e99f5b6eca9629
      path: tools
```
